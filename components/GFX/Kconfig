## components/GFX/Kconfig
```kconfig
menu "LED Display"

    choice
        prompt "display type"
        default LEDDISPLAY_TYPE_64X32_16SCAN
        help
            The LED display type.

        # these work:

        config LEDDISPLAY_TYPE_32X16_8SCAN
            bool "32x16 1/8 scan"

        config LEDDISPLAY_TYPE_32X32_16SCAN
            bool "32x32 1/16 scan"

        config LEDDISPLAY_TYPE_64X32_16SCAN
            bool "64x32 1/16 scan"

        config LEDDISPLAY_TYPE_192x32_16SCAN
            bool "192x32 1/16 scan for LED CUBE"

		# for LED Cube
        config LEDDISPLAY_TYPE_32X32x6_16SCAN
            bool "32x32x6 CUBE 1/16 scan"
     
		# for LED Cube
        config LEDDISPLAY_TYPE_64X32x3_16SCAN
            bool "64x32x3 CUBE 1/16 scan"

        config LEDDISPLAY_TYPE_64X64_32SCAN
            bool "64x64 1/32 scan"

        # these don't work:
        #
        #config LEDDISPLAY_TYPE_32X16_4SCAN
        #    bool "32x16 1/4 scan (doesn't work)"
        #
        #config LEDDISPLAY_TYPE_32X32_8SCAN
        #    bool "32x32 1/8 scan (doesn't work!)"
        #
        #config LEDDISPLAY_TYPE_64X32_8SCAN
        #    bool "64x32 1/8 scan (doesn't work!)"

        # what more exists?

    endchoice

    choice LEDDISPLAY_I2S_FREQ
        prompt "I2S frequency"
        default LEDDISPLAY_I2S_FREQ_20MHZ
        help
            generally choose as high as possible / working

        config LEDDISPLAY_I2S_FREQ_13MHZ
            bool "13.3 MHz"

        config LEDDISPLAY_I2S_FREQ_16MHZ
            bool "16 MHz"

        config LEDDISPLAY_I2S_FREQ_20MHZ
            bool "20 MHz"

        config LEDDISPLAY_I2S_FREQ_26MHZ
            bool "26.6 MHz"

    endchoice

    config LEDDISPLAY_TASK_CORE_AFFINITY
        int "Leddisplay render task core affinity"
        default 0
        range -1 1
        help
            Decides on which CPU core the rendering task will run on.
            0, 1: one of the CPUs
            -1: tskNO_AFFINITY

    config LEDDISPLAY_NUM_DISP_BUFFER
        int "Number of Software Display Buffers"
        default 1
        range 1 2
        help
            Number of Displaybuffers (Software used, not the same as DMA buffers)
            1, 2: one of the CPUs

    choice DISPLAY_UPDATE_MODE
        prompt "UPDATE MODE"
        default DISPLAY_UPDATE_CONT
        help
            Change display update mode to continuous/ or FPS based. FPS based consumes less power, but flickering can be visible.

        config DISPLAY_UPDATE_CONT
            bool "Update continuously"

        config DISPLAY_UPDATE_FPS
            bool "Updates with a fixed FPS rate configured in LEDDISPLAY_MIN_FRAME_RATE"

    endchoice

    config LEDDISPLAY_PRESERVE_RAM_SIZE
        int "keep this much (DMA) RAM free [bytes]"
        default 32768

    config LEDDISPLAY_MIN_FRAME_RATE
        int "minimum frame refresh rate [Hz]"
        default 25
	# default was 50

    config COLOR_DEPTH_BITS
        int "Bit depth of a color byte: 4-8"
        default 6
	# default was 8

    # see val2pwm.c
    choice LEDDISPLAY_CORR_BRIGHT
        prompt "correct perceived brightness"
        default LEDDISPLAY_CORR_BRIGHT_MODIFIED

        config LEDDISPLAY_CORR_BRIGHT_NONE
            bool "no brightness correction"

        config LEDDISPLAY_CORR_BRIGHT_STRICT
            bool "strict brightness correction"
            help
                colour values < 10 is LED fully off, and only values >= 10 will lit the LED,
                using original brightness correction curve

        config LEDDISPLAY_CORR_BRIGHT_MODIFIED
            bool "modified brightness correction"
            help
                only colour value 0 is LED fully off, and any value > 0 will lit the LED,
                the original correction curve is scaled accordingly

        config LEDDISPLAY_CORR_BRIGHT_SRGB
            bool "modified brightness correction with sRGB color space intensities"
            help
                only colour value 0 is LED fully off, and any value > 0 will lit the LED,
                the original correction curve is scaled accordingly

    endchoice

    config LEDDISPLAY_R1_GPIO
        int "GPIO for the R1 signal"
        default 2
        range 0 35
        help
            typically usable pins are 2, 4-5, 12-33

    config LEDDISPLAY_G1_GPIO
        int "GPIO for the G1 signal"
        default 15
        range 0 33
        help
            typically usable pins are 2, 4-5, 12-33

    config LEDDISPLAY_B1_GPIO
        int "GPIO for the B1 signal"
        default 4
        range 0 33
        help
            typically usable pins are 2, 4-5, 12-33

    config LEDDISPLAY_R2_GPIO
        int "GPIO for the R2 signal"
        default 16
        range 0 33
        help
            typically usable pins are 2, 4-5, 12-33

    config LEDDISPLAY_G2_GPIO
        int "GPIO for the G2 signal"
        default 13
        range 0 33
        help
            typically usable pins are 2, 4-5, 12-33

    config LEDDISPLAY_B2_GPIO
        int "GPIO for the B2 signal"
        default 17
        range 0 33
        help
            typically usable pins are 2, 4-5, 12-33

    config LEDDISPLAY_A_GPIO
        int "GPIO for the A signal"
        default 5
        range 0 33
        help
            typically usable pins are 2, 4-5, 12-33

    config LEDDISPLAY_B_GPIO
        int "GPIO for the B signal"
        default 18
        range 0 33
        help
            typically usable pins are 2, 4-5, 12-33

    config LEDDISPLAY_C_GPIO
        int "GPIO for the C signal"
        default 19
        range 0 33
        help
            typically usable pins are 2, 4-5, 12-33

    config LEDDISPLAY_D_GPIO
        int "GPIO for the D signal"
        default 23
        range 0 33
        help
            typically usable pins are 2, 4-5, 12-33

    config LEDDISPLAY_E_GPIO
        int "GPIO for the E signal (1/32 scan types only)"
        default -1
        range -1 33
        help
            typically usable pins are 2, 4-5, 12-33

    config LEDDISPLAY_LAT_GPIO
        int "GPIO for the LAT signal"
        default 0
        range 0 33
        help
            typically usable pins are 2, 4-5, 12-33

    config LEDDISPLAY_OE_GPIO
        int "GPIO for the OE signal"
        default 25
        range 0 33
        help
            typically usable pins are 2, 4-5, 12-33
        

    config LEDDISPLAY_OE0_GPIO
        int "GPIO for the OE0 signal"
        default 25
        range 0 33
        help
            typically usable pins are 2, 4-5, 12-33

    config LEDDISPLAY_OE1_GPIO
        int "GPIO for the OE1 signal"
        default 26
        range 0 33
        help
            typically usable pins are 2, 4-5, 12-33

    config LEDDISPLAY_OE2_GPIO
        int "GPIO for the OE2 signal"
        default 27
        range 0 33
        help
            typically usable pins are 2, 4-5, 12-33

    config LEDDISPLAY_SEL0_GPIO
        int "GPIO for the SEL0 signal"
        default 26
        range 0 33
        help
            typically usable pins are 2, 4-5, 12-33
        
    config LEDDISPLAY_SEL1_GPIO
        int "GPIO for the SEL1 signal"
        default 27
        range 0 33
        help
            typically usable pins are 2, 4-5, 12-33
        
    config LEDDISPLAY_SEL2_GPIO
        int "GPIO for the SEL2 signal"
        default 33
        range 0 33
        help
            typically usable pins are 2, 4-5, 12-33
        
    config LEDDISPLAY_CLK_GPIO
        int "GPIO for the CLK signal"
        default 14
        range 0 33
        help
            typically usable pins are 2, 4-5, 12-33

endmenu
```

## components/I2Cdev/Kconfig
```kconfig
menu "I2Cdev (I2C master mode driver) component config"

    config I2CDEV_SCL_DEF_GPIO
        int "Default GPIO for SCL"
        default 22
        range 0 47
        help
            Default GPIO for the SCL signal. When calling I2Cdev_init(),
            users can pas the SDA and SCL pin numbers of their choice.
            If either is passed as -1, the default will be used

    config I2CDEV_SCL_PULLUP_EN
        bool "Internal Pull-Up enable for SCL"
        default true
        help
            Select this to enable inernal pull-up for SCL signal

    config I2CDEV_SDA_PULLUP_EN
        bool "Internal Pull-Up enable for SDA"
        default true
        help
            Select this to enable inernal pull-up for SDA signal

    config I2CDEV_SDA_DEF_GPIO
        int "Default GPIO for SDA"
        default 21
        range 0 47
        help
            Default GPIO for the SDA signal. When calling I2Cdev_init(),
            users can pas the SDA and SCL pin numbers of their choice.
            If either is passed as -1, the default will be used

    config I2CDEV_DEF_SCL_FREQ
        int "Default master SCL frequency, in Hz"
        default 100000
        range 100000 1000000
        help
            Master SCL frequency of the I2C peripheral. Set when calling I2Cdev_init().

endmenu
```

## components/ICM42605/Kconfig
```kconfig
menu "ICM426XX Driver configuration"

    choice
        prompt "Seral Interface"
        default ICM426XX_ESP32_SERIF
        help
            Chosen serial interface for communicating with an ICM426XX.
            By default I2C is used, using the I2CDev component.
            Choosing I2CDev, check it's configuration to select the correct configuration
        # these work:

        config ICM426XX_USE_I2C
            bool "Use I2C via I2CDev"

        config ICM426XX_USE_SPI4
            bool "Use SPI 4-wire mode (To-Be-Implemented)"

    endchoice

    config I2CM426XX_DEV_NAME
        int "Las 3 digits of the ICM Device type"
        default 600
        range 600 688
        help
            Last 3 digits of the ICM426XX device.
            For example if ICM42605 is used this should be equal to 605.

    config I2CM426XX_DEV_ADDRESS
        int "I2C Only - BUS Address of device"
        default 0x68
        range 0x0 0x256
        help
            Address of the device in I2C mode

    config I2CM426XX_DEV_INT1_GPIO
        int "INT1 GPIO on ESP32"
        default 1
        range 0 47
        help
            GPIO pin number for INT1 signal
            0-47: Valid GPIO
            -1: Not used

    config I2CM426XX_DEV_INT2_GPIO
        int "INT2 GPIO on ESP32"
        default 2
        range 0 47
        help
            GPIO pin number for INT2 signal
            0-47: Valid GPIO
            -1: Not used
endmenu
```

## components/ICM426XX/Kconfig
```kconfig
menu "ICM426XX Driver configuration"

    choice
        prompt "Seral Interface"
        default ICM426XX_USE_I2C 
        help
            Chosen serial interface for communicating with an ICM426XX.
            By default I2C is used, using the I2CDev component.
            Choosing I2CDev, check it's configuration to select the correct configuration
        # these work:

        config ICM426XX_USE_I2C
            bool "Use I2C via I2CDev"

        config ICM426XX_USE_SPI4
            bool "Use SPI 4-wire mode (To-Be-Implemented)"

    endchoice

    config ICM426XX_LOCAL_LOG_LEVEL
        int "Local logging level of component"
        default 1
        range 0 5
        help
            Logging verbosity level of component
            0 - No ouput
            1 - error (lowest)
            2 - warning
            3 - info
            4 - debug
            5 - verbose (highest)

    config ICM426XX_DEV_NAME
        int "ICM device type, all 5 digits"
        default 42605
        range 42600 42688
        help
            ICM device type, all 5 digits of the ICM426XX device.
            For example if ICM42605 is used this should be equal to 42605

    config ICM426XX_DEV_ADDRESS
        hex "I2C Only - BUS Address of device"
        default 0x68
        range 0x0 0x256
        help
            Address of the device in I2C mode

    config ICM426XX_DEV_INT1_GPIO
        int "INT1 GPIO on ESP32"
        default 1
        range 0 47
        help
            GPIO pin number for INT1 signal
            0-47: Valid GPIO
            -1: Not used

    config ICM426XX_DEV_INT2_GPIO
        int "INT2 GPIO on ESP32"
        default 2
        range 0 47
        help
            GPIO pin number for INT2 signal
            0-47: Valid GPIO
            -1: Not used

    config ICM426XX_TASK_NAME
        string "String name of the driver task, to be used in vTaskList and diagnostics"
        default "ICM_task"
        help
            Name string of driver task.

    config ICM426XX_TASK_CORE_AFFINITY
        int "Which core should we run the ICM426XX driver"
        default 0
        range 0 1
        help
            Core number for the driver task
            0 or 1. For single core devices, this is not used

    config ICM426XX_TASK_STACK_SIZE
        int "Driver task stack size"
        default 2000
        range 1000 10000
        help
            Task stack size in bytes, used when calling xTaskCreate
            recomended 1000 or more

    config ICM426XX_TASK_PRIORITY
        int "FreeRTOS task priority of driver task"
        default 8
        range 1 10
        help
            Task priority of the driver. Up to you!
endmenu
```
